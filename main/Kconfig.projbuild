## main/Kconfig.projbuild
```kconfig
menu "LED Strip Configuration"

    config WEB_MOUNT_POINT
        string "Website mount point in SPIFFS"
        default "/data"
        help
            Specify the mount point in SPIFFS.

endmenu
```

## sdkconfig.defaults
```kconfig
CONFIG_PARTITION_TABLE_CUSTOM=y
CONFIG_PARTITION_TABLE_CUSTOM_FILENAME="partitions.csv"
CONFIG_PARTITION_TABLE_FILENAME="partitions.csv"
CONFIG_SPIFFS_OBJ_NAME_LEN=64
CONFIG_ESPTOOLPY_FLASHSIZE_4MB=y
CONFIG_HTTPD_MAX_REQ_HDR_LEN=1024
```
